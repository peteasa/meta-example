/dts-v1/;
/include/ "zynq7-base.dtsi"
/include/ "parallella-example.dtsi"
/include/ "parallella-hdmi-example.dtsi"
/ {
	chosen {
		bootargs = "console=ttyPS0,115200 root=/dev/mmcblk0p2 rw rootwait earlyprintk";
	} ;
} ;
